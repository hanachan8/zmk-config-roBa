## dts/bindings/behaviors/roba,behavior-android-switcher.yaml
```yaml
description: Android Win keys and Alt-Tab held until both physical keys are released
compatible: "roba,behavior-android-switcher"
include: one_param.yaml
properties:
  bindings:
    type: phandle-array
    required: true
    description: Normal Tab behavior, used when no Win key is held
  number-layer:
    type: int
    required: true
```
