## config/west.yml
```yaml
manifest:
  remotes:
    - name: zmkfirmware
      url-base: https://github.com/zmkfirmware
    - name: kumamuk-git
      url-base: https://github.com/kumamuk-git
    - name: badjeff
      url-base: https://github.com/badjeff
    - name: ssbb
      url-base: https://github.com/ssbb
      
  projects:
    - name: zmk
      remote: zmkfirmware
      revision:  v0.3
      import: app/west.yml
    - name: zmk-pmw3610-driver
      remote: kumamuk-git
      revision: main

   - name: zmk-input-processor-report-rate-limit
     remote: badjeff
     revision: f43f37aae7aaa7bf0ec4d432683b873a7e3a8efa
     path: modules/zmk-input-processor-report-rate-limit

    - name: zmk-listeners
      remote: ssbb
      revision: v1
      path: modules/zmk-listeners
      
  self:
    path: config
```
